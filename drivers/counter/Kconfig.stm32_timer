## drivers/counter/Kconfig.stm32_timer
```kconfig
# Copyright (c) 2021 Kent Hall
# SPDX-License-Identifier: Apache-2.0

config COUNTER_TIMER_STM32
	bool "Enable STM32 Counters"
	select USE_STM32_LL_TIM
```

## dts/bindings/counter/st,stm32-counter.yaml
```yaml
# Copyright (c) 2021, Kent Hall
# SPDX-License-Identifier: Apache-2.0

description: STM32 counters

compatible: "st,stm32-counter"

include: base.yaml

properties:
    label:
      required: true

    st,prescaler:
      type: int
      required: true
      description: Clock prescaler at the input of the timer
```
